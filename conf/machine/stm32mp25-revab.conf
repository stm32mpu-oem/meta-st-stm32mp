## conf/machine/stm32mp25-revab.conf
```bitbake
#@TYPE: Machine
#@NAME: stm32mp25-revab
#@DESCRIPTION: Configuration for all STM32MP25 boards RevAB(EV, DK, ...)
#@NEEDED_BSPLAYERS: layers/meta-openembedded/meta-oe layers/meta-openembedded/meta-python

# Define specific familly common machine name
MACHINEOVERRIDES =. "stm32mp2common:stm32mp25common:stm32mp25revabcommon:"

include conf/machine/include/st-machine-common-stm32mp.inc
include conf/machine/include/st-machine-providers-stm32mp.inc

# =========================================================================
# SOC
# =========================================================================
STM32MP_SOC_NAME = "stm32mp25"
STM32MP_ENCRYPT_SOC_NAME:append = " stm32mp25 "

# =========================================================================
# Chip architecture
# =========================================================================
DEFAULTTUNE = "cortexa35"
include conf/machine/include/arm/armv8a/tune-cortexa35.inc

# =========================================================================
# boot scheme
# =========================================================================
BOOTSCHEME_LABELS = "optee"

# =========================================================================
# boot device
# =========================================================================
# Define the boot device supported
BOOTDEVICE_LABELS += "emmc"
#BOOTDEVICE_LABELS += "nand-4-256-1024"
BOOTDEVICE_LABELS += "nor-sdcard"
BOOTDEVICE_LABELS += "sdcard"

# =========================================================================
# Machine settings
# =========================================================================
# Define list of devicetree per supported storage
STM32MP_DT_FILES_EMMC   += "stm32mp257f-ev1-revB"
STM32MP_DT_FILES_SDCARD += "stm32mp257f-ev1-revB"
STM32MP_DT_FILES_NOR    += "stm32mp257f-ev1-revB"

EXTERNAL_DEVICETREE_SDCARD = "stm32mp257f-ev1-revB-ca35tdcid-ostl"
EXTERNAL_DEVICETREE_SDCARD =+ "stm32mp257f-ev1-revB-ca35tdcid-ostl-m33-examples"
EXTERNAL_DEVICETREE_EMMC = "stm32mp257f-ev1-revB-ca35tdcid-ostl"
EXTERNAL_DEVICETREE_EMMC =+ "stm32mp257f-ev1-revB-ca35tdcid-ostl-m33-examples"

STM32MP_DT_FILES_SDCARD += "${@bb.utils.contains('EXTERNAL_DT_ENABLED', '1', '${EXTERNAL_DEVICETREE_SDCARD}', '', d)}"
STM32MP_DT_FILES_EMMC += "${@bb.utils.contains('EXTERNAL_DT_ENABLED', '1', '${EXTERNAL_DEVICETREE_EMMC}', '', d)}"
# =========================================================================
# Machine features
# =========================================================================
MACHINE_FEATURES += "splashscreen"
MACHINE_FEATURES += "watchdog"
MACHINE_FEATURES += "bluetooth"
MACHINE_FEATURES += "wifi"
MACHINE_FEATURES += "usbg0"

# GPU
MACHINE_FEATURES += "${@'gpu' if d.getVar('ACCEPT_EULA_'+d.getVar('MACHINE')) == '1' else ''}"
MACHINE_FEATURES += "openvx"
MACHINE_FEATURES += "opencl"
MACHINE_FEATURES += "vulkan"

# M33
MACHINE_FEATURES += "m33copro"

# Bluetooth
BLUETOOTH_LIST += ""
# Wifi
WIFI_LIST += "linux-firmware-rtl8192ce"
# PCIe
PCI_LIST += "linux-firmware-rtl8168"

# activate external dt
EXTERNAL_DT_ENABLED = "1"

# =========================================================================
# TEMPORARY HACK
# =========================================================================
# TF-A: configuration not available
#TF_A_CONFIG:remove = "uart"
#TF_A_CONFIG:remove = "usb"

# Flashlayout
# No metadata generated and supported for the moment
STM32MP_METADATA_DATA ?= ""

# GPU have vulkan
DISTRO_FEATURES:append = " ${@bb.utils.contains('DISTRO', 'openstlinux-eglfs', '', 'vulkan', d)} "
DISTRO_FEATURES:append = " opencl "


# --------------------------------------
# U-BOOT
# --------------------------------------
# STM32mp25 revab
# STM32mp25
UBOOT_CONFIG:append:stm32mp25revabcommon = " ${@bb.utils.contains_any('BOOTSCHEME_LABELS', 'optee', 'trusted_stm32mp25', '', d)} "
UBOOT_CONFIG[trusted_stm32mp25] = "stm32mp25_revA_defconfig,,u-boot.dtb"

# --------------------------------------
# fip
# --------------------------------------
FIP_BL31_ENABLE = "1"

# --------------------------------------
# Image
# --------------------------------------
# Proposed value for vendorfs is 48MB
STM32MP_VENDORFS_SIZE = "49152"
```

## conf/machine/stm32mp25.conf
```bitbake
#@TYPE: Machine
#@NAME: stm32mp25
#@DESCRIPTION: Configuration for all STM32MP25 boards (EV, DK, ...)
#@NEEDED_BSPLAYERS: layers/meta-openembedded/meta-oe layers/meta-openembedded/meta-python

include conf/machine/include/st-machine-common-stm32mp.inc
include conf/machine/include/st-machine-providers-stm32mp.inc

# Define specific familly common machine name
MACHINEOVERRIDES .= ":stm32mp2common:stm32mp25common"

# =========================================================================
# SOC
# =========================================================================
STM32MP_SOC_NAME = "stm32mp25"

# =========================================================================
# Chip architecture
# =========================================================================
DEFAULTTUNE = "cortexa35"
include conf/machine/include/arm/armv8a/tune-cortexa35.inc

# =========================================================================
# boot scheme
# =========================================================================
BOOTSCHEME_LABELS = "optee"

# =========================================================================
# boot device
# =========================================================================
# Define the boot device supported
#BOOTDEVICE_LABELS += "emmc"
#BOOTDEVICE_LABELS += "nand-4-256"
#BOOTDEVICE_LABELS += "nor-sdcard"
BOOTDEVICE_LABELS += "sdcard"

# =========================================================================
# Machine settings
# =========================================================================
# Define list of devicetree per board
STM32MP_DT_FILES_DK += "stm32mp257f-dk"
STM32MP_DT_FILES_EV += "stm32mp257f-ev"
STM32MP_DT_FILES_EV += "stm32mp257f-valid3 "
STM32MP_DT_FILES_ED += "stm32mp257f-valid3-daughter "

# =========================================================================
# Machine features
# =========================================================================
MACHINE_FEATURES += "splashscreen"
MACHINE_FEATURES += "watchdog"
MACHINE_FEATURES += "bluetooth"
MACHINE_FEATURES += "wifi"
MACHINE_FEATURES += "usbg0"

# GPU
MACHINE_FEATURES += "${@'gpu' if d.getVar('ACCEPT_EULA_'+d.getVar('MACHINE')) == '1' else ''}"
MACHINE_FEATURES += "openvx"
MACHINE_FEATURES += "opencl"
MACHINE_FEATURES += "vulkan"

# M33
MACHINE_FEATURES += "m33copro"

# Bluetooth
BLUETOOTH_LIST += ""
# Wifi
WIFI_LIST += "linux-firmware-rtl8192ce"
# PCIe
PCI_LIST += "linux-firmware-rtl8168"

# =========================================================================
# Kernel
# =========================================================================
KERNEL_IMAGETYPE:aarch64     =  "${@bb.utils.contains('MACHINE_FEATURES', 'fit', 'fitImage', 'Image.gz', d)}"
KERNEL_ALT_IMAGETYPE:aarch64 = "vmlinux"

# warning, the kernel devicetree are located on sub directory 'st'
KERNEL_SUB_PATH = "st/"
STM32MP_KERNEL_DEVICETREE = "${@' '.join('${KERNEL_SUB_PATH}%s.dtb' % d for d in '${STM32MP_DEVICETREE}'.split())}"
STM32MP_KERNEL_DEVICETREE += "${@' '.join('${KERNEL_SUB_PATH}%s.dtb' % d for d in '${CUBE_M4_EXAMPLES_DT}'.split())}"
STM32MP_KERNEL_DEVICETREE += "${@' '.join('${KERNEL_SUB_PATH}%s.dtb' % d for d in '${LINUX_A7_EXAMPLES_DT}'.split())}"

# =========================================================================
# EXTLINUX
# =========================================================================
# extlinux conf; force usage of Image.gz
UBOOT_EXTLINUX_KERNEL_IMAGE = "/Image.gz"
UBOOT_EXTLINUX_KERNEL_ARGS = "rootwait rw  earlyprintk swiotlb=noforce earlycon clk_ignore_unused"
# =========================================================================
# u-boot
# =========================================================================
UBOOT_CONFIG:stm32mp2common = "${@bb.utils.contains_any('BOOTSCHEME_LABELS', 'optee', 'trusted_mp25', '', d)}"

UBOOT_CONFIG[trusted_mp25] = "stm32mp25_defconfig,,u-boot.dtb"

# =========================================================================
# tf-a
# =========================================================================
TF_A_CONFIG[optee] = "${STM32MP_DEVICETREE},SPD=opteed,,${@bb.utils.contains('FIP_BL31_ENABLE', '1', 'bl31 dtbs', 'dtbs', d)},bl31 fwconfig"

# =========================================================================
# Fip
# =========================================================================
# Configure use of BL31
FIP_BL31_ENABLE = "1"

# =========================================================================
# Flashlayout
# =========================================================================
#FSBL1
STM32MP_FSBL1_NAME = "fsbla"

# For Programmer, add fip-ddr entrey which contins only ddr firmware
STM32MP_SSBL_PROGAMMER_NAME = "fip-ddr"

# For Programmer, add a thrid entry for fip (contains all boot stage)
STM32MP_SSBL2_PROGAMMER_NAME = "fip-boot"
FLASHLAYOUT_PARTITION_TYPE:${STM32MP_SSBL2_PROGAMMER_NAME} = "FIP"

FLASHLAYOUT_PARTITION_ENABLE:${STM32MP_SSBL2_PROGAMMER_NAME} = "-"
FLASHLAYOUT_PARTITION_ID:${STM32MP_SSBL_PROGAMMER_NAME} = "0x02"
FLASHLAYOUT_PARTITION_ID:${STM32MP_SSBL2_PROGAMMER_NAME} = "0x03"
FLASHLAYOUT_PARTITION_OFFSET:${STM32MP_SSBL2_PROGAMMER_NAME} = "0x0"
FLASHLAYOUT_PARTITION_BIN2LOAD:${STM32MP_SSBL_PROGAMMER_NAME} = "fip/fip-<TYPE>-ddr.bin"
FLASHLAYOUT_PARTITION_BIN2LOAD:${STM32MP_SSBL2_PROGAMMER_NAME} = "${STM32MP_SSBL1_DATA}"

FLASHLAYOUT_PARTITION_ENABLE:deleteall:${STM32MP_SSBL2_PROGAMMER_NAME} = "-"
FLASHLAYOUT_PARTITION_REPLACE_PATTERNS:${STM32MP_SSBL2_PROGAMMER_NAME}:append = " deleteall;${BOOTSCHEME_REPLACE} "

FLASHLAYOUT_PROGRAMMER_SECTIONS = "${STM32MP_FSBL_PROGAMMER_NAME} ${STM32MP_SSBL_PROGAMMER_NAME}  ${STM32MP_SSBL2_PROGAMMER_NAME}"

# =========================================================================
# TEMPORARY HACK
# =========================================================================
# firmware update
MACHINE_FEATURES:remove = "fw-update"
ENABLE_FLASHLAYOUT_CONFIG_FWUP = "1"
TF_A_ENABLE_METADATA = "0"

# TF-A: configuration not available
#TF_A_CONFIG:remove = "uart"
#TF_A_CONFIG:remove = "usb"

# Flashlayout
# No metadata generated and supported for the moment
STM32MP_METADATA_DATA ?= ""

# GPU have vulkan
DISTRO_FEATURES:append = " ${@bb.utils.contains('DISTRO', 'openstlinux-eglfs', '', 'vulkan', d)} "
DISTRO_FEATURES:append = " opencl "

# Alsa configuration for valid3
ALSA_IMAGE_INSTALL:stm32mp2common = "${@bb.utils.contains('COMBINED_FEATURES', 'alsa', 'alsa-state-stm32mp2', '', d)} "

# Define M33 example installation dir
M33_INSTALLDIR = "${STM32MP_USERFS_MOUNTPOINT}"
M33_PACKAGE_4USERFS = "${@bb.utils.contains('ST_USERFS','1','1','0',d)}"

# Define the name of default copro firmware executed @boot time
DEFAULT_COPRO_FIRMWARE = "OpenAMP_TTY_echo_CM33_NonSecure"
# =========================================================================
# m33copro
# =========================================================================
M33COPRO_LIST ?= "\
    m33projects-stm32mp2 \
    "
M33COPRO_IMAGE_INSTALL = "${@bb.utils.contains('MACHINE_FEATURES', 'm33copro', '${M33COPRO_LIST}', '', d)}"
```
